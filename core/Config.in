## core/Config.in
```kconfig
menu "Lunar OS"
source "$BR2_EXTERNAL_LUNAR_PATH/package/swaylock/Config.in"
source "$BR2_EXTERNAL_LUNAR_PATH/package/swayidle/Config.in"
source "$BR2_EXTERNAL_LUNAR_PATH/package/mako/Config.in"
source "$BR2_EXTERNAL_LUNAR_PATH/package/tofi/Config.in"
source "$BR2_EXTERNAL_LUNAR_PATH/package/brightnessctl/Config.in"
endmenu
```

## core/configs/lunar_x86_64_defconfig
```kconfig
# Lunar OS Core: an independent x86_64 system, every package compiled from
# source by Buildroot. Starts from Buildroot's own pc_x86_64_efi board.
BR2_x86_64=y
BR2_x86_corei7=y
BR2_CCACHE=y
BR2_CCACHE_DIR="$(HOME)/.buildroot-ccache"
BR2_GLOBAL_PATCH_DIR="board/pc/patches"

# Toolchain: built here, glibc + C++
BR2_TOOLCHAIN_BUILDROOT_GLIBC=y
BR2_TOOLCHAIN_BUILDROOT_CXX=y
BR2_PACKAGE_HOST_LINUX_HEADERS_CUSTOM_6_12=y
BR2_GENERATE_LOCALE="en_US.UTF-8"
BR2_ENABLE_LOCALE_WHITELIST="C en_US"

# System
BR2_TARGET_GENERIC_HOSTNAME="lunar"
BR2_TARGET_GENERIC_ISSUE="Lunar OS"
BR2_INIT_SYSTEMD=y
BR2_SYSTEM_BIN_SH_BASH=y
BR2_TARGET_GENERIC_ROOT_PASSWD="lunar"
BR2_TARGET_GENERIC_GETTY_PORT="tty1"
BR2_ROOTFS_MERGED_USR=y
BR2_ROOTFS_USERS_TABLES="$(BR2_EXTERNAL_LUNAR_PATH)/board/lunar/users.txt"
BR2_ROOTFS_OVERLAY="$(BR2_EXTERNAL_LUNAR_PATH)/board/lunar/overlay"
BR2_ROOTFS_POST_BUILD_SCRIPT="$(BR2_EXTERNAL_LUNAR_PATH)/board/lunar/post-build.sh"
BR2_ROOTFS_POST_IMAGE_SCRIPT="$(BR2_EXTERNAL_LUNAR_PATH)/board/lunar/post-image.sh"

# Kernel: Buildroot's PC config plus laptop drivers
BR2_LINUX_KERNEL=y
BR2_LINUX_KERNEL_CUSTOM_VERSION=y
BR2_LINUX_KERNEL_CUSTOM_VERSION_VALUE="6.12.47"
BR2_LINUX_KERNEL_USE_CUSTOM_CONFIG=y
BR2_LINUX_KERNEL_CUSTOM_CONFIG_FILE="board/pc/linux.config"
BR2_LINUX_KERNEL_CONFIG_FRAGMENT_FILES="$(BR2_EXTERNAL_LUNAR_PATH)/board/lunar/linux.fragment"
BR2_LINUX_KERNEL_INSTALL_TARGET=y
BR2_LINUX_KERNEL_NEEDS_HOST_OPENSSL=y
BR2_LINUX_KERNEL_NEEDS_HOST_LIBELF=y

# Firmware: Intel graphics, Intel/Realtek/Atheros Wi-Fi and Ethernet
BR2_PACKAGE_LINUX_FIRMWARE=y
BR2_PACKAGE_LINUX_FIRMWARE_I915=y
BR2_PACKAGE_LINUX_FIRMWARE_IWLWIFI_3160=y
BR2_PACKAGE_LINUX_FIRMWARE_IWLWIFI_3168=y
BR2_PACKAGE_LINUX_FIRMWARE_IWLWIFI_5000=y
BR2_PACKAGE_LINUX_FIRMWARE_IWLWIFI_6000G2A=y
BR2_PACKAGE_LINUX_FIRMWARE_IWLWIFI_6000G2B=y
BR2_PACKAGE_LINUX_FIRMWARE_IWLWIFI_7260=y
BR2_PACKAGE_LINUX_FIRMWARE_IWLWIFI_7265D=y
BR2_PACKAGE_LINUX_FIRMWARE_IWLWIFI_8000C=y
BR2_PACKAGE_LINUX_FIRMWARE_IWLWIFI_8265=y
BR2_PACKAGE_LINUX_FIRMWARE_ATHEROS_9170=y
BR2_PACKAGE_LINUX_FIRMWARE_ATHEROS_9271=y
BR2_PACKAGE_LINUX_FIRMWARE_RTL_81XX=y
BR2_PACKAGE_LINUX_FIRMWARE_RTL_87XX=y
BR2_PACKAGE_LINUX_FIRMWARE_RTL_88XX=y
BR2_PACKAGE_LINUX_FIRMWARE_RTL_8169=y
BR2_PACKAGE_INTEL_MICROCODE=y
BR2_PACKAGE_WIRELESS_REGDB=y

# systemd: logins, networking, DNS, clock
BR2_PACKAGE_SYSTEMD_LOGIND=y
BR2_PACKAGE_SYSTEMD_NETWORKD=y
BR2_PACKAGE_SYSTEMD_RESOLVED=y
BR2_PACKAGE_SYSTEMD_TIMESYNCD=y
BR2_PACKAGE_SYSTEMD_HOSTNAMED=y
BR2_PACKAGE_LINUX_PAM=y
BR2_PACKAGE_UTIL_LINUX=y
BR2_PACKAGE_UTIL_LINUX_LOGIN=y
BR2_PACKAGE_UTIL_LINUX_AGETTY=y
BR2_PACKAGE_UTIL_LINUX_BINARIES=y

# Wi-Fi
BR2_PACKAGE_IWD=y
BR2_PACKAGE_ACPID=y

# Graphics: Mesa with software rendering. Mesa 26's Intel drivers (crocus,
# iris) need LLVM, which is hours more to compile; Sway draws with pixman.
BR2_PACKAGE_MESA3D=y
BR2_PACKAGE_MESA3D_GALLIUM_DRIVER_SOFTPIPE=y
BR2_PACKAGE_MESA3D_GBM=y
BR2_PACKAGE_MESA3D_OPENGL_EGL=y
BR2_PACKAGE_MESA3D_OPENGL_ES=y
BR2_PACKAGE_MESA3D_OPENGL_GLX=y

# Desktop: Sway, riced as Lunar
BR2_PACKAGE_SWAY=y
BR2_PACKAGE_SWAY_SWAYBAR=y
BR2_PACKAGE_SWAY_SWAYNAG=y
BR2_PACKAGE_SWAYLOCK=y
BR2_PACKAGE_SWAYIDLE=y
BR2_PACKAGE_MAKO=y
BR2_PACKAGE_TOFI=y
BR2_PACKAGE_BRIGHTNESSCTL=y
BR2_PACKAGE_GDK_PIXBUF=y
BR2_PACKAGE_LIBRSVG=y
BR2_PACKAGE_SWAYBG=y
BR2_PACKAGE_FOOT=y
BR2_PACKAGE_SEATD=y
BR2_PACKAGE_SEATD_DAEMON=y
BR2_PACKAGE_DEJAVU=y
BR2_PACKAGE_LIBERATION=y
BR2_PACKAGE_XKEYBOARD_CONFIG=y

# Apps: GTK3 (also what Firefox from ltxs runs on), file manager, icons
BR2_PACKAGE_LIBGTK3=y
BR2_PACKAGE_LIBGTK3_WAYLAND=y
BR2_PACKAGE_LIBGTK3_X11=y
BR2_PACKAGE_XORG7=y
BR2_PACKAGE_XLIB_LIBX11=y
BR2_PACKAGE_XLIB_LIBXCOMPOSITE=y
BR2_PACKAGE_XLIB_LIBXDAMAGE=y
BR2_PACKAGE_XLIB_LIBXEXT=y
BR2_PACKAGE_XLIB_LIBXFIXES=y
BR2_PACKAGE_XLIB_LIBXRANDR=y
BR2_PACKAGE_XLIB_LIBXRENDER=y
BR2_PACKAGE_XLIB_LIBXCURSOR=y
BR2_PACKAGE_XLIB_LIBXI=y
BR2_PACKAGE_XLIB_LIBXTST=y
BR2_PACKAGE_DBUS_GLIB=y
BR2_PACKAGE_PCMANFM=y
BR2_PACKAGE_ADWAITA_ICON_THEME=y
BR2_PACKAGE_HICOLOR_ICON_THEME=y
BR2_PACKAGE_SHARED_MIME_INFO=y

# Sound and Bluetooth
BR2_PACKAGE_ALSA_LIB=y
BR2_PACKAGE_ALSA_UTILS=y
BR2_PACKAGE_PIPEWIRE=y
BR2_PACKAGE_LUA=y
BR2_PACKAGE_LUA_5_4=y
BR2_PACKAGE_WIREPLUMBER=y
BR2_PACKAGE_BLUEZ5_UTILS=y
BR2_PACKAGE_BLUEZ5_UTILS_CLIENT=y

# Laptop power
BR2_PACKAGE_UPOWER=y
BR2_PACKAGE_POLKIT=y

# Tools
BR2_PACKAGE_DIALOG=y
BR2_PACKAGE_LIBCURL=y
BR2_PACKAGE_LIBCURL_CURL=y
BR2_PACKAGE_XZ=y
BR2_PACKAGE_ZSTD=y
BR2_PACKAGE_EFIBOOTMGR=y
BR2_PACKAGE_OPENSSH=y
BR2_PACKAGE_GIT=y
BR2_PACKAGE_BASH=y
BR2_PACKAGE_BASH_COMPLETION=y
BR2_PACKAGE_SUDO=y
BR2_PACKAGE_NANO=y
BR2_PACKAGE_HTOP=y
BR2_PACKAGE_KBD=y
BR2_PACKAGE_TZDATA=y
BR2_PACKAGE_CA_CERTIFICATES=y
BR2_PACKAGE_E2FSPROGS=y
BR2_PACKAGE_DOSFSTOOLS=y
BR2_PACKAGE_DOSFSTOOLS_MKFS_FAT=y
BR2_PACKAGE_GPTFDISK=y
BR2_PACKAGE_GPTFDISK_SGDISK=y
BR2_PACKAGE_RSYNC=y
BR2_PACKAGE_WGET=y
BR2_PACKAGE_JQ=y

# Disk image: GPT, EFI boot partition + ext4 root, written to a USB as-is
BR2_TARGET_ROOTFS_EXT2=y
BR2_TARGET_ROOTFS_EXT2_4=y
BR2_TARGET_ROOTFS_EXT2_SIZE="2G"
BR2_TARGET_ROOTFS_EXT2_LABEL="lunar-root"
# BR2_TARGET_ROOTFS_TAR is not set
BR2_TARGET_GRUB2=y
BR2_TARGET_GRUB2_X86_64_EFI=y
BR2_PACKAGE_HOST_DOSFSTOOLS=y
BR2_PACKAGE_HOST_GENIMAGE=y
BR2_PACKAGE_HOST_MTOOLS=y
```

## core/package/brightnessctl/Config.in
```kconfig
config BR2_PACKAGE_BRIGHTNESSCTL
	bool "brightnessctl"
	depends on BR2_PACKAGE_SYSTEMD
	help
	  Read and control screen and keyboard backlight.
```

## core/package/mako/Config.in
```kconfig
config BR2_PACKAGE_MAKO
	bool "mako"
	depends on BR2_PACKAGE_WAYLAND
	depends on BR2_PACKAGE_SYSTEMD
	select BR2_PACKAGE_WAYLAND_PROTOCOLS
	select BR2_PACKAGE_CAIRO
	select BR2_PACKAGE_PANGO
	select BR2_PACKAGE_LIBGLIB2
	help
	  Notification daemon for Wayland.
```

## core/package/swayidle/Config.in
```kconfig
config BR2_PACKAGE_SWAYIDLE
	bool "swayidle"
	depends on BR2_PACKAGE_WAYLAND
	depends on BR2_PACKAGE_SYSTEMD
	select BR2_PACKAGE_WAYLAND_PROTOCOLS
	help
	  Idle management daemon for Wayland.
```

## core/package/swaylock/Config.in
```kconfig
config BR2_PACKAGE_SWAYLOCK
	bool "swaylock"
	depends on BR2_PACKAGE_WAYLAND
	select BR2_PACKAGE_WAYLAND_PROTOCOLS
	select BR2_PACKAGE_LIBXKBCOMMON
	select BR2_PACKAGE_CAIRO
	select BR2_PACKAGE_CAIRO_PNG
	help
	  Screen locker for Wayland.
```

## core/package/tofi/Config.in
```kconfig
config BR2_PACKAGE_TOFI
	bool "tofi"
	depends on BR2_PACKAGE_WAYLAND
	select BR2_PACKAGE_WAYLAND_PROTOCOLS
	select BR2_PACKAGE_LIBXKBCOMMON
	select BR2_PACKAGE_CAIRO
	select BR2_PACKAGE_PANGO
	select BR2_PACKAGE_HARFBUZZ
	select BR2_PACKAGE_FREETYPE
	select BR2_PACKAGE_LIBGLIB2
	help
	  App launcher for Wayland.
```
